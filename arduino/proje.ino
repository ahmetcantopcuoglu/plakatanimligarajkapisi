#include <SPI.h>
#include <Wire.h>
#include <Servo.h>
#include <Adafruit_GFX.h>
#include <Adafruit_SSD1306.h>
#include <OLED_I2C.h>
#define echoPin 4
#define trigPin 3

OLED  myOLED(SDA, SCL, 8);
Servo motor;

int Derece = 90;
int sure;
int mesafe;
char arac;

Adafruit_SSD1306 display(-1);

const unsigned char araba [] PROGMEM = {
  0xff, 0xff, 0xff, 0xff, 0xc0, 0x00, 0x00, 0x00, 0x01, 0xff, 0xff, 0xff, 0xf0, 0xff, 0xff, 0xff,
  0x80, 0x00, 0x00, 0x00, 0x00, 0x00, 0x07, 0xff, 0xff, 0xf0, 0xff, 0xff, 0xfe, 0x00, 0x00, 0x00,
  0x00, 0x00, 0x00, 0x03, 0xff, 0xff, 0xf0, 0xff, 0xff, 0xfc, 0x00, 0x60, 0x30, 0x00, 0x00, 0x00,
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  0xff, 0xff, 0xff, 0xff, 0xff, 0xff, 0xff, 0xff, 0x80, 0x70
};


void setup()
{
  motor.attach(2);
  display.begin(SSD1306_SWITCHCAPVCC, 0x3C);
  Wire.begin();

  // Tampon Bellek sıfırlama
  display.clearDisplay();

  pinMode(8, OUTPUT);
  pinMode(9, OUTPUT);
  pinMode(10, OUTPUT);
  pinMode(11, OUTPUT);
  pinMode(12, OUTPUT);
  pinMode(trigPin, OUTPUT);
  pinMode(echoPin, INPUT);
  Serial.begin(9600);
}
void loop()

{

  digitalWrite(8, HIGH);
  digitalWrite(9, HIGH);
  digitalWrite(10, HIGH);
  digitalWrite(11, LOW);




  if (Serial.available() > 0)
  {
    arac = Serial.read();
    Serial.print(arac);


    if (arac == '1') {


      digitalWrite(8, HIGH);
      digitalWrite(9, LOW);
      digitalWrite(10, LOW);
      digitalWrite(11, HIGH);
      delay(200);
      digitalWrite(11, LOW);
      delay(100);
      digitalWrite(11, HIGH);
      delay(250);
      digitalWrite(11, LOW);

      display.setTextSize(1, 3 );
      display.setTextColor(WHITE);
      display.setCursor(27, 13);
      display.println("TANIMLI ARAC");
      display.setCursor(35, 42);
      display.println("16 UN 190");
      display.display();

      for (Derece = 90; Derece > 0; Derece--)
      {
        motor.write(Derece);
        delay(35);
      }
      delay(3000);
geri:
      digitalWrite(trigPin, HIGH);
      delayMicroseconds(10);
      digitalWrite(trigPin, LOW);
      sure = pulseIn(echoPin, HIGH);
      mesafe = (sure / 2) / 29.1;

      if (mesafe > 10) {
        for (Derece = 0; Derece < 90; Derece++)
        {
          motor.write(Derece);
          delay(35);
        }
      }
      else {
        delay(2000);
        goto geri;

      }
    }



    display.clearDisplay();

    if (arac == '2') {
      digitalWrite(8, LOW);
      digitalWrite(9, HIGH);
      digitalWrite(10, HIGH);
      digitalWrite(11, HIGH);
      delay(500);
      digitalWrite(8, HIGH);
      digitalWrite(9, HIGH);
      digitalWrite(10, HIGH);
      digitalWrite(11, LOW);
      delay(300);
      digitalWrite(8, LOW);
      digitalWrite(9, HIGH);
      digitalWrite(10, HIGH);
      digitalWrite(11, HIGH);
      delay(500);
      digitalWrite(8, HIGH);
      digitalWrite(9, HIGH);
      digitalWrite(10, HIGH);
      digitalWrite(11, LOW);
      delay(300);
      digitalWrite(8, LOW);
      digitalWrite(9, HIGH);
      digitalWrite(10, HIGH);
      digitalWrite(11, HIGH);
      delay(500);
      digitalWrite(8, HIGH);
      digitalWrite(9, HIGH);
      digitalWrite(10, HIGH);
      digitalWrite(11, LOW);
      display.setTextSize(1, 4);
      display.setTextColor(WHITE);
      display.setCursor(25, 17);
      display.println("YABANCI ARAC");


      display.display();
      delay(5000);
      display.clearDisplay();
    }


    else (arac == '0');
    {
      digitalWrite(8, HIGH);
      digitalWrite(9, HIGH);
      digitalWrite(10, HIGH);

    }
  }
  display.drawBitmap(15, -5, araba, 100, 50, WHITE);
  display.setTextSize(1);
  display.setTextColor(WHITE);
  display.setCursor(45, 47);
  display.println("OTOPARK");
  display.setCursor(45, 55);
  display.println("Sistemi");
  display.display();
  delay(1000);
  display.clearDisplay();
}
